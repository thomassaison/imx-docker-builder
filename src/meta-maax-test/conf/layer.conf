## src/meta-maax-test/conf/layer.conf
```bitbake
# We have a conf and classes directory, add to BBPATH
BBPATH .= ":${LAYERDIR}"

# We have recipes-* directories, add to BBFILES
BBFILES += "${LAYERDIR}/recipes-*/*/*.bb \
            ${LAYERDIR}/recipes-*/*/*.bbappend"

BBFILE_COLLECTIONS += "meta-maax-test"
BBFILE_PATTERN_meta-maax-test = "^${LAYERDIR}/"
BBFILE_PRIORITY_meta-maax-test = "9"

LAYERDEPENDS_meta-maax-test = "core"
LAYERSERIES_COMPAT_meta-maax-test = "hardknott"

MAAXBOARD_GIT_HOST_MIRROR ?= "git://git@github.com/Avnet"
```
